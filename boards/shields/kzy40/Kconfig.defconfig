## boards/shields/kzy40/Kconfig.defconfig
```kconfig
if SHIELD_KZY40_LEFT

config ZMK_KEYBOARD_NAME
    default "kzy40"

endif

if SHIELD_KZY40_LEFT || SHIELD_KZY40_RIGHT

config ZMK_SPLIT
    default y

endif
```

## boards/shields/kzy40/Kconfig.shield
```kconfig
config SHIELD_KZY40_LEFT
    def_bool $(shields_list_contains,kzy40_left)
config SHIELD_KZY40_RIGHT
    def_bool $(shields_list_contains,kzy40_right)
```

## config/west.yml
```yaml
manifest:
  remotes:
    - name: zmkfirmware
      url-base: https://github.com/zmkfirmware
    - name: sekigon-gonnoc
      url-base: https://github.com/sekigon-gonnoc
  projects:
    - name: zmk
      remote: zmkfirmware
      revision: develop
      import: app/west.yml
  self:
    path: config
```
